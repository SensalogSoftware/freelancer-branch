## boards/arm/pill_v0_nrf5340/Kconfig.board
```kconfig
# Copyright (c) 2024 Nordic Semiconductor ASA
# SPDX-License-Identifier: Apache-2.0

config BOARD_PILL_V0_NRF5340
	bool "Pill V0 nRF5340"
	depends on SOC_NRF5340_CPUAPP_QKAA
```

## boards/arm/pill_v0_nrf5340/Kconfig.defconfig
```kconfig
# Copyright (c) 2024 Nordic Semiconductor ASA
# SPDX-License-Identifier: Apache-2.0

if BOARD_PILL_V0_NRF5340

config BOARD
	default "pill_v0_nrf5340"

	
endif
```

## examples/adc/build/Kconfig/Kconfig.shield
```kconfig
osource "/Users/bedmonds/Developer/Sensalog/Freelancer/freelancer-branch/boards/shields/*/Kconfig.shield"
osource "/opt/nordic/ncs/v2.4.1/nrf/boards/shields/*/Kconfig.shield"
```

## examples/blinky/build/Kconfig/Kconfig.shield.defconfig
```kconfig
osource "/Users/bedmonds/Developer/Sensalog/Freelancer/freelancer-branch/boards/shields/*/Kconfig.defconfig"
osource "/opt/nordic/ncs/v2.4.1/nrf/boards/shields/*/Kconfig.defconfig"
```

## examples/icm20948/build/Kconfig/Kconfig.shield
```kconfig
osource "/Users/bedmonds/Downloads/pill-v0-2da757df062c55a3d8de09b04de46386ed06fd3e/boards/shields/*/Kconfig.shield"
osource "/opt/nordic/ncs/v2.5.0/nrf/boards/shields/*/Kconfig.shield"
```
